## components/sd_card_manager/Kconfig
```kconfig
# SPDX-FileCopyrightText: 2026 Thomas Stoll
# SPDX-License-Identifier: Apache-2.0

menu "SD Card Manager"
    choice SD_CARD_MANAGER_BUS_MODE
        prompt "Default SD card bus mode"
        default SD_CARD_MANAGER_BUS_SDMMC_4BIT
        help
            Bus mode used until another mode is selected in the web interface
            settings. The selection is stored in NVS and applies after a restart.
            Both pin sets below are always compiled in.

        config SD_CARD_MANAGER_BUS_SDMMC_4BIT
            bool "4-bit SDMMC"

        config SD_CARD_MANAGER_BUS_SPI
            bool "SPI"
    endchoice

    config SD_CARD_MANAGER_SDMMC_FREQ_KHZ
        int "SDMMC clock frequency (kHz)"
        range 400 20000
        default 10000

    config SD_CARD_MANAGER_SPI_FREQ_KHZ
        int "SPI clock frequency (kHz)"
        range 400 20000
        default 10000

    config SD_CARD_MANAGER_GPIO_CARD_DETECT
        int "Card-detect GPIO (active high)"
        range 0 48
        default 7

    config SD_CARD_MANAGER_MOUNT_POINT
        string "VFS mount point"
        default "/sdcard"

    config SD_CARD_MANAGER_GPIO_CLK
        int "SDMMC CLK GPIO"
        range 0 48
        default 14

    config SD_CARD_MANAGER_GPIO_CMD
        int "SDMMC CMD GPIO"
        range 0 48
        default 15

    config SD_CARD_MANAGER_GPIO_D0
        int "SDMMC D0 GPIO"
        range 0 48
        default 2

    config SD_CARD_MANAGER_GPIO_D1
        int "SDMMC D1 GPIO"
        range 0 48
        default 4

    config SD_CARD_MANAGER_GPIO_D2
        int "SDMMC D2 GPIO"
        range 0 48
        default 5

    config SD_CARD_MANAGER_GPIO_D3
        int "SDMMC D3 GPIO"
        range 0 48
        default 6

    config SD_CARD_MANAGER_GPIO_SPI_MISO
        int "SPI MISO GPIO"
        range 0 48
        default 2

    config SD_CARD_MANAGER_GPIO_SPI_MOSI
        int "SPI MOSI GPIO"
        range 0 48
        default 15

    config SD_CARD_MANAGER_GPIO_SPI_CS
        int "SPI CS GPIO"
        range 0 48
        default 6

    config SD_CARD_MANAGER_GPIO_SPI_CLK
        int "SPI CLK GPIO"
        range 0 48
        default 14
endmenu
```
